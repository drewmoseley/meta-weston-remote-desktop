## conf/layer.conf
```bitbake
# We have a conf and classes directory, add to BBPATH
BBPATH .= ":${LAYERDIR}"

# We have recipes-* directories, add to BBFILES
BBFILES += "${LAYERDIR}/recipes-*/*/*.bb \
            ${LAYERDIR}/recipes-*/*/*.bbappend"

BBFILE_COLLECTIONS += "meta-weston-remote-desktop"
BBFILE_PATTERN_meta-weston-remote-desktop = "^${LAYERDIR}/"
BBFILE_PRIORITY_meta-weston-remote-desktop = "50"

LAYERDEPENDS_meta-weston-remote-desktop = "core"
LAYERSERIES_COMPAT_meta-weston-remote-desktop = "scarthgap"
```
